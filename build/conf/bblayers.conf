## build/conf/bblayers.conf
```bitbake
# POKY_BBLAYERS_CONF_VERSION is increased each time build/conf/bblayers.conf
# changes incompatibly
POKY_BBLAYERS_CONF_VERSION = "2"

BBPATH = "${TOPDIR}"
BBFILES ?= ""

BBLAYERS ?= " \
  /home/retpolanne/Dev/orange-pi-one-plus-image/poky/meta \
  /home/retpolanne/Dev/orange-pi-one-plus-image/poky/meta-poky \
  /home/retpolanne/Dev/orange-pi-one-plus-image/poky/meta-yocto-bsp \
  /home/retpolanne/Dev/orange-pi-one-plus-image/build/workspace \
  "
```
